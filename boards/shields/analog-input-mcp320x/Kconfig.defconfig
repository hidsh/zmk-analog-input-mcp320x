## boards/shields/analog-input-mcp320x/Kconfig.defconfig
```kconfig
if SHIELD_ANALOG_INPUT_MCP320X

    config ZMK_KEYBOARD_NAME
        default "ANALOG_INPUT_MC"

    config ZMK_BLE
        bool
        default y

endif
```

## boards/shields/analog-input-mcp320x/Kconfig.shield
```kconfig
# No whitespace after the comma or in your keyboard name!
config SHIELD_ANALOG_INPUT_MCP320X
    def_bool $(shields_list_contains,analog-input-mcp320x)
```

## config/west.yml
```yaml
manifest:
  projects:
    - name: zmk
      remote: zmkfirmware
      revision: main
      import: app/west.yml
    - name: zmk-analog-input-mcp320x
      remote: hidsh
      revision: main
  self:
    path: config
```
